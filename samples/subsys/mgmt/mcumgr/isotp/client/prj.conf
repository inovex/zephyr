## CMakeLists.txt
```
# Copyright (c) 2026, inovex GmbH
# SPDX-License-Identifier: Apache-2.0

cmake_minimum_required(VERSION 3.20.0)

find_package(Zephyr REQUIRED HINTS $ENV{ZEPHYR_BASE})
project(mcumgr_isotp_client)

target_sources(app PRIVATE src/main.c)
```

## sample.yaml
```
sample:
  name: MCUmgr ISO-TP (CAN) SMP client shell
  description: >
    Interactive "smpc" shell that drives MCUmgr image, OS and file management
    over the ISO-TP (CAN, ISO 15765-2) transport to perform firmware updates on
    remote nodes, with runtime peer retargeting and a littlefs image source.
common:
  tags:
    - mcumgr
    - smp
    - canbus
    - isotp
  # Interactive sample: it needs a CAN bus and a live SMP server/node to do
  # anything, so it is build-only under twister rather than self-verifying.
  build_only: true
tests:
  sample.mgmt.mcumgr.smp.isotp.client:
    platform_allow:
      - native_sim
    integration_platforms:
      - native_sim
    depends_on:
      - can
```

## prj.conf
```kconfig
# Copyright (c) 2026, inovex GmbH
# SPDX-License-Identifier: Apache-2.0

# --- Logging / console ---
CONFIG_LOG=y
CONFIG_MCUMGR_TRANSPORT_ISOTP_LOG_LEVEL_DBG=y

# --- CAN + ISO-TP ---
CONFIG_CAN=y
CONFIG_ISOTP=y

# --- MCUmgr SMP client ---
CONFIG_NET_BUF=y
CONFIG_ZCBOR=y
CONFIG_MCUMGR=y
CONFIG_SMP_CLIENT=y

# ISO-TP (CAN) transport. The IDs are the mirror image of the server: the
# client transmits SMP data on the server's RX id (0x80) and receives on the
# server's TX id (0x180). Flow control uses the same two IDs (normal addressing).
CONFIG_MCUMGR_TRANSPORT_ISOTP=y
CONFIG_MCUMGR_TRANSPORT_ISOTP_RX_ID=0x180
CONFIG_MCUMGR_TRANSPORT_ISOTP_TX_ID=0x80

# OS management client (provides os_mgmt_client_echo()).
CONFIG_MCUMGR_GRP_OS_CLIENT=y
CONFIG_MCUMGR_GRP_OS_CLIENT_ECHO=y

# Larger thread stacks for the system / mcumgr work queues on native_sim.
CONFIG_MAIN_STACK_SIZE=4096
CONFIG_MCUMGR_TRANSPORT_WORKQUEUE_STACK_SIZE=4096
```

## boards/native_sim.conf
```kconfig
# Copyright (c) 2026, inovex GmbH
# SPDX-License-Identifier: Apache-2.0

# native_sim backs the devicetree flash with the flash simulator; the littlefs
# image source (/lfs) lives on its storage_partition.
CONFIG_FLASH_SIMULATOR=y
```

## boards/native_sim.overlay
```dts
/*
 * Copyright (c) 2026, inovex GmbH
 *
 * SPDX-License-Identifier: Apache-2.0
 *
 * Route the MCUmgr ISO-TP transport to the native Linux SocketCAN driver so
 * that the client and server samples (two separate native_sim processes) can
 * talk to each other over a shared host CAN interface (e.g. vcan0).
 *
 * Adjust "host-interface" to match the interface you created on the host.
 */

/ {
	chosen {
		zephyr,canbus = &can0;
	};
};

&can0 {
	status = "okay";
	host-interface = "vcan0";
};

&can_loopback0 {
	status = "disabled";
};
```

## src/main.c
```c
/*
 * Copyright (c) 2026, inovex GmbH
 *
 * SPDX-License-Identifier: Apache-2.0
 */

/*
 * MCUmgr SMP client over ISO-TP (CAN) - "main controller".
 *
 * This application turns the device into a main controller that performs
 * firmware updates on other nodes over the ISO-TP (CAN) transport, driven
 * interactively from the console with the "smpc" shell commands (see
 * smp_client_shell.c). Firmware images and files are sourced from the local
 * littlefs file system mounted at /lfs.
 *
 * The ISO-TP transport and the SMP client are brought up by the MCUmgr handler
 * initialisation and the shell; main() only reports startup status.
 */

#include <zephyr/kernel.h>
#include <zephyr/fs/fs.h>
#include <zephyr/logging/log.h>
#include <zephyr/mgmt/mcumgr/transport/smp_isotp.h>

LOG_MODULE_REGISTER(main, LOG_LEVEL_INF);

#define LFS_MOUNT_POINT "/lfs"

int main(void)
{
	struct fs_statvfs sbuf;
	int rc;

	LOG_INF("MCUmgr ISO-TP (CAN) SMP client (main controller) started");
	LOG_INF("Default peer: TX 0x%x / RX 0x%x; retarget with 'smpc isotp target <rx> <tx>'",
		CONFIG_MCUMGR_TRANSPORT_ISOTP_TX_ID, CONFIG_MCUMGR_TRANSPORT_ISOTP_RX_ID);

	/* The file system is auto-mounted via the devicetree fstab entry; report
	 * whether it is available so missing storage is obvious at boot.
	 */
	rc = fs_statvfs(LFS_MOUNT_POINT, &sbuf);
	if (rc == 0) {
		LOG_INF("Image source %s mounted: %lu KiB free", LFS_MOUNT_POINT,
			(unsigned long)(sbuf.f_bfree * sbuf.f_frsize) / 1024);
	} else {
		LOG_WRN("%s not mounted (%d): stage firmware there before uploading",
			LFS_MOUNT_POINT, rc);
	}

	LOG_INF("Ready. Type 'smpc' for SMP client commands, 'fs' to manage %s",
		LFS_MOUNT_POINT);

	return 0;
}
```
