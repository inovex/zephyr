## CMakeLists.txt
```
# Copyright (c) 2026, inovex GmbH
# SPDX-License-Identifier: Apache-2.0

cmake_minimum_required(VERSION 3.20.0)

find_package(Zephyr REQUIRED HINTS $ENV{ZEPHYR_BASE})
project(mcumgr_isotp_server)

target_sources(app PRIVATE src/main.c)
```

## sample.yaml
```
sample:
  name: MCUmgr ISO-TP (CAN) SMP server
  description: >
    MCUmgr SMP server exposed over the ISO-TP (CAN, ISO 15765-2) transport.
    Answers OS management commands received over a CAN bus.
common:
  tags:
    - mcumgr
    - smp
    - canbus
    - isotp
  harness: console
tests:
  sample.mgmt.mcumgr.smp.isotp.server:
    platform_allow:
      - native_sim
    integration_platforms:
      - native_sim
    depends_on:
      - can
```

## prj.conf
```kconfig
# Copyright (c) 2026, inovex GmbH
# SPDX-License-Identifier: Apache-2.0

# --- Logging / console ---
CONFIG_LOG=y
CONFIG_MCUMGR_TRANSPORT_ISOTP_LOG_LEVEL_DBG=y

# --- CAN + ISO-TP ---
CONFIG_CAN=y
CONFIG_ISOTP=y

# --- MCUmgr SMP server ---
CONFIG_NET_BUF=y
CONFIG_ZCBOR=y
CONFIG_MCUMGR=y

# ISO-TP (CAN) transport. RX/TX IDs are the defaults (0x80 / 0x180); the client
# must use the mirror image of these (TX 0x80 / RX 0x180).
CONFIG_MCUMGR_TRANSPORT_ISOTP=y

# Management groups exposed by this server.
CONFIG_MCUMGR_GRP_OS=y
CONFIG_MCUMGR_GRP_OS_ECHO=y
CONFIG_MCUMGR_GRP_OS_INFO=y
CONFIG_FLASH=y
CONFIG_FLASH_MAP=y
CONFIG_STREAM_FLASH=y
CONFIG_IMG_MANAGER=y
CONFIG_MCUMGR_GRP_IMG=y
CONFIG_MCUMGR_GRP_OS=y
CONFIG_MCUMGR_GRP_STAT=y

# Larger thread stacks for the system / mcumgr work queues on native_sim.
CONFIG_MAIN_STACK_SIZE=2048
CONFIG_MCUMGR_TRANSPORT_WORKQUEUE_STACK_SIZE=4096

CONFIG_SHELL=y
CONFIG_MCUBOOT_SHELL=y
```

## boards/native_sim.conf
```kconfig
# Copyright (c) 2026, inovex GmbH
# SPDX-License-Identifier: Apache-2.0

# Plain native_sim has no MCUboot/code partition (no FLASH_LOAD_OFFSET), so the
# image management server group cannot be built; this build answers OS/stat
# commands (echo etc.) for the client sample over vcan0.
CONFIG_MCUMGR_GRP_IMG=n
CONFIG_IMG_MANAGER=n
CONFIG_MCUBOOT_SHELL=n
```

## boards/native_sim.overlay
```dts
/*
 * Copyright (c) 2026, inovex GmbH
 *
 * SPDX-License-Identifier: Apache-2.0
 *
 * Route the MCUmgr ISO-TP transport to the native Linux SocketCAN driver so
 * that the server and client samples (two separate native_sim processes) can
 * talk to each other over a shared host CAN interface (e.g. vcan0).
 *
 * Adjust "host-interface" to match the interface you created on the host.
 */

/ {
	chosen {
		zephyr,canbus = &can0;
	};
};

&can0 {
	status = "okay";
	host-interface = "vcan0";
};

&can_loopback0 {
	status = "disabled";
};
```

## src/main.c
```c
/*
 * Copyright (c) 2026, inovex GmbH
 *
 * SPDX-License-Identifier: Apache-2.0
 */

/*
 * MCUmgr SMP server over ISO-TP (CAN).
 *
 * This application does almost nothing in main(): the ISO-TP transport is
 * brought up automatically by the MCUmgr handler initialisation, binds to the
 * configured RX CAN identifier and waits for incoming SMP requests. The OS
 * management group answers commands such as "echo" and "info".
 *
 * It is meant to be driven by the companion "client" sample (or any SMP/MCUmgr
 * tool that speaks ISO-TP), see the README for how to wire them together.
 */

#include <zephyr/kernel.h>
#include <zephyr/logging/log.h>

LOG_MODULE_REGISTER(main, LOG_LEVEL_INF);

int main(void)
{
	LOG_INF("MCUmgr ISO-TP (CAN) SMP server started");
	LOG_INF("Listening for SMP requests on RX CAN id 0x%x, replying on 0x%x",
		CONFIG_MCUMGR_TRANSPORT_ISOTP_RX_ID, CONFIG_MCUMGR_TRANSPORT_ISOTP_TX_ID);

	LOG_INF("App version: %s", CONFIG_MCUBOOT_IMGTOOL_SIGN_VERSION);

	return 0;
}
```
